## conf/distro/poky-tinker-gui.conf
```bitbake
require poky-tinker.conf

DISTRO = "poky-tinker-gui"
DISTRO_NAME = "poky-tinker-gui"
DISTRO_VERSION = "1.0"

DISTRO_FEATURES:append = " opengl x11 systemd"


VC4DTBO = "vc4-fkms-v3d"
```

## conf/distro/poky-tinker.conf
```bitbake
require conf/distro/poky-altcfg.conf

DISTRO = "poky-tinker"
DISTROOVERRIDES = "poky:poky-altcfg"

DISTRO_FEATURES:append = " rauc"

LICENSE_FLAGS_ACCEPTED:append = " synaptics-killswitch commercial "

ENABLE_I2C = "1"

ENABLE_UART = "1"
RPI_EXTRA_CONFIG = "uart_2ndstage=1"

WAVESHARE_1024X600_C_2_1 = "1"

KERNEL_MODULE_AUTOLOAD:rpi += " i2c-dev i2c-bcm2708 bcm2835_wdt r8152 "

IMAGE_CLASSES:append = " bootroot-image "

RPI_KERNEL_DEVICETREE_OVERLAYS:append = " overlays/googlevoicehat-soundcard.dtbo "
RPI_EXTRA_CONFIG:append = " \n \
\n \
\n \
dtoverlay=googlevoicehat-soundcard \n \
\n \
"
# dtoverlay=i2s-mmap \n


hostname:pn-base-files = ""

DISTRO_FEATURES:append = " pulseaudio "

PACKAGECONFIG:append:pn-pulseaudio = " systemd"

SERIAL_CONSOLES = "115200;tty1"
CMDLINE_SERIAL = "console=tty1,115200"
CMDLINE_KGDB = "kgdboc=tty1,115200"
```

## conf/layer.conf
```bitbake
# We have a conf and classes directory, add to BBPATH
BBPATH .= ":${LAYERDIR}"

# We have recipes-* directories, add to BBFILES
BBFILES += "${LAYERDIR}/recipes-*/*/*.bb \
            ${LAYERDIR}/recipes-*/*/*.bbappend"

BBFILE_COLLECTIONS += "meta-tinker"
BBFILE_PATTERN_meta-tinker = "^${LAYERDIR}/"
BBFILE_PRIORITY_meta-tinker = "666"

LAYERDEPENDS_meta-tinker = "core"
LAYERSERIES_COMPAT_meta-tinker = "kirkstone langdale mickledore nanbield scarthgap styhead"
```
